/*
* A2l file for testing ASAP2 parser.
*/ ASAP2_VERSION 1 60 A2ML_VERSION 1 1
/begin PROJECT project_name "project description"
/begin HEADER "Desc header" VERSION "version info" PROJECT_NO 12345 /end HEADER
/begin MODULE SYSTEM "Desc SYSTEM MODULE"
/begin MOD_COMMON "Desc mod_common" DEPOSIT ABSOLUTE ALIGNMENT_BYTE 1 BYTE_ORDER MSB_FIRST ALIGNMENT_WORD 2 ALIGNMENT_LONG 4 ALIGNMENT_INT64 8 ALIGNMENT_FLOAT32_IEEE 4 ALIGNMENT_FLOAT64_IEEE 4 /end MOD_COMMON
/begin IF_DATA XCP
 /begin PROTOCOL_LAYER 0x0100 2000 2000 2000 65535 2000 0005 0005 0x08 0x0008 BYTE_ORDER_MSB_LAST ADDRESS_GRANULARITY_BYTE SEED_AND_KEY_EXTERNAL_FUNCTION "SeedNKeyXcp.dll" /end PROTOCOL_LAYER
/end IF_DATA
/begin MEASUREMENT Measurement_1 "Measurement_1 description" UWORD NO_COMPU_METHOD 0 0 0 65535 ECU_ADDRESS 0x4000b6ee FORMAT "%8.5" /begin BIT_OPERATION RIGHT_SHIFT 4 LEFT_SHIFT 6 SIGN_EXTEND /end BIT_OPERATION /end MEASUREMENT
/begin MEASUREMENT Measurement_3_Array "Array test 3" UWORD NO_COMPU_METHOD 1 0 0 65535 ARRAY_SIZE 8 ECU_ADDRESS 0x4000074c FORMAT "%8.5" /end MEASUREMENT
/begin MEASUREMENT Measurement_2_Array[0] "Array test part 0.
        Row 2" UWORD NO_COMPU_METHOD 1 0 0 65535 ECU_ADDRESS 0x4000074c FORMAT "%8.5" /end MEASUREMENT
/begin MEASUREMENT Measurement_2_Array[1] "Array test part 1." UWORD NO_COMPU_METHOD 1 0 0 65535 ECU_ADDRESS 0x4000074c DISPLAY_IDENTIFIER Measurement_2_ArrayDISPLAY_IDENTIFIER[1] FORMAT "%8.5"
 /begin ANNOTATION ANNOTATION_LABEL "Measurement_2_Array[1] annotation label" ANNOTATION_ORIGIN "Measurement_2_Array[1] annotation origin"
  /begin ANNOTATION_TEXT "Measurement_2_Array[1] annotation test line1.\r\n" "Measurement_2_Array[1] annotation test line2.\r\n" "Measurement_2_Array[1] annotation test line3." /end ANNOTATION_TEXT
 /end ANNOTATION
/end MEASUREMENT
/begin COMPU_VTAB compu_vtab_boolean "" TAB_VERB 2 0 "FALSE" 1 "TRUE" /end COMPU_VTAB
/begin COMPU_VTAB compu_vtab_example1 "" TAB_VERB 5 0 "compu_vtab_example1_level0" 1 "compu_vtab_example1_level1" 2 "compu_vtab_example1_level2" 11 "compu_vtab_example1_level11" 13 "compu_vtab_example1_level13" DEFAULT_VALUE "compu_vtab_example1_error" /end COMPU_VTAB
/begin COMPU_VTAB compu_vtab_example2 "" TAB_VERB 3 0 "compu_vtab_example2_Idle" 1 "compu_vtab_example2_Strtg" 2 "compu_vtab_example2_Actv" /end COMPU_VTAB
/end MODULE
/end PROJECT
