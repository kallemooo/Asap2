/*
* A2l file for testing ASAP2 parser.
*/ ASAP2_VERSION 1 60 A2ML_VERSION 1 1
/begin PROJECT project_name "project description"
/begin HEADER "Desc header" VERSION "version info" PROJECT_NO A12345 /end HEADER
/begin MODULE SYSTEM "Desc SYSTEM MODULE"
/begin MOD_COMMON "Desc mod_common" DEPOSIT ABSOLUTE ALIGNMENT_BYTE 1 BYTE_ORDER MSB_FIRST ALIGNMENT_WORD 2 ALIGNMENT_LONG 4 ALIGNMENT_INT64 8 ALIGNMENT_FLOAT32_IEEE 4 ALIGNMENT_FLOAT64_IEEE 4 S_REC_LAYOUT TEST_S_REC_LAYOUT DATA_SIZE 32 /end MOD_COMMON
/begin IF_DATA XCP
 /begin PROTOCOL_LAYER 0x0100 2000 2000 2000 65535 2000 0005 0005 0x08 0x0008 BYTE_ORDER_MSB_LAST ADDRESS_GRANULARITY_BYTE SEED_AND_KEY_EXTERNAL_FUNCTION "SeedNKeyXcp.dll" /end PROTOCOL_LAYER
/end IF_DATA
/begin MOD_PAR "Module parameters for XCP configuration" VERSION "0" SUPPLIER "Supplier example" CUSTOMER "Customer example" ECU "ECU example" CPU_TYPE "PPC" PHONE_NO "1234567890" NO_OF_INTERFACES 1 ADDR_EPK 0x12345 ECU_CALIBRATION_OFFSET 0x1000 EPK "EPROM identifier test"
 SYSTEM_CONSTANT "System_Constant_1" "-3.45"
 SYSTEM_CONSTANT "System_Constant_2" "5.67"
 SYSTEM_CONSTANT "System_Constant_3" "Text in System Constant"
 /begin MEMORY_LAYOUT PRG_DATA 0x0000 0x8000 -1 -1 -1 -1 -1
  /begin IF_DATA DIM
   /begin DP_BLOB EXTERN /end DP_BLOB
   /* memory type */
   /begin PA_BLOB DIRECT /end PA_BLOB
   /* addressing mode */ /end IF_DATA
 /end MEMORY_LAYOUT
 /begin MEMORY_SEGMENT Code "main program" CODE FLASH INTERN 0x0015fff8 0x8 -1 -1 -1 -1 -1
  /begin IF_DATA XCP
   /begin SEGMENT 0x0 0x1 0x0 0x0 0x0 /begin CHECKSUM XCP_ADD_14 MAX_BLOCK_SIZE 0x100 /end CHECKSUM
    /begin PAGE 0x0 ECU_ACCESS_WITH_XCP_ONLY XCP_READ_ACCESS_NOT_ALLOWED XCP_WRITE_ACCESS_NOT_ALLOWED /end PAGE
   /end SEGMENT
  /end IF_DATA
 /end MEMORY_SEGMENT
 /begin MEMORY_SEGMENT flash_calib_offline "flash_calib_offline" OFFLINE_DATA FLASH INTERN 0x00140000 0xab00 -1 -1 -1 -1 -1
  /begin IF_DATA XCP
   /begin SEGMENT 0x1 0x1 0x0 0x0 0x0 /begin CHECKSUM XCP_ADD_14 MAX_BLOCK_SIZE 0x100 /end CHECKSUM
    /begin PAGE 0x0 ECU_ACCESS_WITH_XCP_ONLY XCP_READ_ACCESS_WITH_ECU_ONLY XCP_WRITE_ACCESS_NOT_ALLOWED /end PAGE
   /end SEGMENT
  /end IF_DATA
 /end MEMORY_SEGMENT
 /begin MEMORY_SEGMENT flash_calib_online "flash_calib_online" DATA FLASH INTERN 0x0014ab00 0x154f8 -1 -1 -1 -1 -1
  /begin IF_DATA XCP
   /begin SEGMENT 0x2 0x2 0x0 0x0 0x0 /begin CHECKSUM XCP_ADD_14 MAX_BLOCK_SIZE 0x100 /end CHECKSUM
    /begin PAGE 0x0 ECU_ACCESS_WITH_XCP_ONLY XCP_READ_ACCESS_WITH_ECU_ONLY XCP_WRITE_ACCESS_NOT_ALLOWED /end PAGE
    /begin PAGE 0x1 ECU_ACCESS_WITH_XCP_ONLY XCP_READ_ACCESS_WITH_ECU_ONLY XCP_WRITE_ACCESS_WITH_ECU_ONLY /end PAGE
   /end SEGMENT
  /end IF_DATA
 /end MEMORY_SEGMENT
/end MOD_PAR
/begin MEASUREMENT Measurement_1 "Measurement_1 description" UWORD NO_COMPU_METHOD 0 0.0 0.0 65535.0 ECU_ADDRESS 0x4000b6ee FORMAT "%8.5" /begin BIT_OPERATION RIGHT_SHIFT 4 LEFT_SHIFT 6 SIGN_EXTEND /end BIT_OPERATION /end MEASUREMENT
/begin MEASUREMENT Measurement_3_Array "Array test 3" UWORD NO_COMPU_METHOD 1 0. 0. 65535. ARRAY_SIZE 8 ECU_ADDRESS 0x4000074c FORMAT "%8.5" /end MEASUREMENT
/begin MEASUREMENT Measurement_2_Array[0] "Array test part 0.
        Row 2" UWORD NO_COMPU_METHOD 1 0. 0. 65535. ECU_ADDRESS 0x4000074c FORMAT "%8.5" /end MEASUREMENT
/begin MEASUREMENT Measurement_2_Array[1] "Array test part 1." UWORD NO_COMPU_METHOD 1 0. 0. 65535. ECU_ADDRESS 0x4000074c DISPLAY_IDENTIFIER Measurement_2_ArrayDISPLAY_IDENTIFIER[1] FORMAT "%8.5"
 /begin ANNOTATION ANNOTATION_LABEL "Measurement_2_Array[1] annotation label" ANNOTATION_ORIGIN "Measurement_2_Array[1] annotation origin"
  /begin ANNOTATION_TEXT "Measurement_2_Array[1] annotation test line1.\r\n" "Measurement_2_Array[1] annotation test line2.\r\n" "Measurement_2_Array[1] annotation test line3." /end ANNOTATION_TEXT
 /end ANNOTATION
/end MEASUREMENT
/begin MEASUREMENT Measurement_01 "Preasure_chamber_01" UBYTE CompuMethod_02 1 0. 0. 255. ECU_ADDRESS 0xE0010000 BIT_MASK 0x1F
 /begin IF_DATA XCP
  /begin DAQ_EVENT VARIABLE /begin DEFAULT_EVENT_LIST EVENT 0 EVENT 1 EVENT 2 EVENT 3 EVENT 4 /end DEFAULT_EVENT_LIST /end DAQ_EVENT
 /end IF_DATA
/end MEASUREMENT
/begin MEASUREMENT Measurement_02 "Preasure_chamber_02" UBYTE CompuMethod_02 1 0. 0. 255. ECU_ADDRESS 0xE0020000 BIT_MASK 0x1F
 /begin IF_DATA XCP
  /begin DAQ_EVENT VARIABLE /begin DEFAULT_EVENT_LIST EVENT 0 EVENT 1 EVENT 2 EVENT 3 EVENT 4 /end DEFAULT_EVENT_LIST /end DAQ_EVENT
 /end IF_DATA
/end MEASUREMENT
/begin MEASUREMENT Measurement_03 "Preasure_chamber_03" UWORD CompuMethod_03 1 0. 0. 65535. ECU_ADDRESS 0xE0030000 FORMAT "%6.0"
 /begin IF_DATA XCP
  /begin DAQ_EVENT VARIABLE /begin DEFAULT_EVENT_LIST EVENT 0 EVENT 1 EVENT 2 EVENT 3 EVENT 4 /end DEFAULT_EVENT_LIST /end DAQ_EVENT
 /end IF_DATA
/end MEASUREMENT
/begin MEASUREMENT Measurement_04 "Preasure_chamber_04" UWORD CompuMethod_05 1 0. 0. 359.999 ECU_ADDRESS 0xE0040000 FORMAT "%6.3"
 /begin IF_DATA XCP
  /begin DAQ_EVENT VARIABLE /begin DEFAULT_EVENT_LIST EVENT 0 EVENT 1 EVENT 2 EVENT 3 EVENT 4 /end DEFAULT_EVENT_LIST /end DAQ_EVENT
 /end IF_DATA
/end MEASUREMENT
/begin MEASUREMENT Measurement_05 "Preasure_chamber_05" UWORD CompuMethod_01 1 0. 0. 65535. ECU_ADDRESS 0xE0050000 FORMAT "%6.0"
 /begin IF_DATA XCP
  /begin DAQ_EVENT VARIABLE /begin DEFAULT_EVENT_LIST EVENT 0 EVENT 1 EVENT 2 EVENT 3 EVENT 4 /end DEFAULT_EVENT_LIST /end DAQ_EVENT
 /end IF_DATA
/end MEASUREMENT
/begin MEASUREMENT Measurement_06 "Preasure_chamber_06" UWORD CompuMethod_01 1 0. 0. 65535. ECU_ADDRESS 0xE0060000 FORMAT "%6.0"
 /begin IF_DATA XCP
  /begin DAQ_EVENT VARIABLE /begin DEFAULT_EVENT_LIST EVENT 0 EVENT 1 EVENT 2 EVENT 3 EVENT 4 /end DEFAULT_EVENT_LIST /end DAQ_EVENT
 /end IF_DATA
/end MEASUREMENT
/begin MEASUREMENT Measurement_07 "Preasure_chamber_07" UBYTE CompuMethod_02 1 0. 0. 255. ECU_ADDRESS 0xE0070000 BIT_MASK 0x1F
 /begin IF_DATA XCP
  /begin DAQ_EVENT VARIABLE /begin DEFAULT_EVENT_LIST EVENT 0 EVENT 1 EVENT 2 EVENT 3 EVENT 4 /end DEFAULT_EVENT_LIST /end DAQ_EVENT
 /end IF_DATA
/end MEASUREMENT
/begin MEASUREMENT Measurement_08 "Preasure_chamber_08" UWORD CompuMethod_05 1 0. 0. 359.999 ECU_ADDRESS 0xE0080000 FORMAT "%6.3"
 /begin IF_DATA XCP
  /begin DAQ_EVENT VARIABLE /begin DEFAULT_EVENT_LIST EVENT 0 EVENT 1 EVENT 2 EVENT 3 EVENT 4 /end DEFAULT_EVENT_LIST /end DAQ_EVENT
 /end IF_DATA
/end MEASUREMENT
/begin MEASUREMENT Measurement_09 "Preasure_chamber_09" UWORD CompuMethod_03 1 0. 0. 65535. ECU_ADDRESS 0xE0090000 FORMAT "%6.0"
 /begin IF_DATA XCP
  /begin DAQ_EVENT VARIABLE /begin DEFAULT_EVENT_LIST EVENT 0 EVENT 1 EVENT 2 EVENT 3 EVENT 4 /end DEFAULT_EVENT_LIST /end DAQ_EVENT
 /end IF_DATA
/end MEASUREMENT
/begin MEASUREMENT Measurement_10 "Preasure_chamber_10" UWORD CompuMethod_03 1 0. 0. 65535. ECU_ADDRESS 0xE00A0000 FORMAT "%6.0"
 /begin IF_DATA XCP
  /begin DAQ_EVENT VARIABLE /begin DEFAULT_EVENT_LIST EVENT 0 EVENT 1 EVENT 2 EVENT 3 EVENT 4 /end DEFAULT_EVENT_LIST /end DAQ_EVENT
 /end IF_DATA
/end MEASUREMENT
/begin MEASUREMENT Measurement_11 "Preasure_chamber_11" UWORD CompuMethod_03 1 0. 0. 65535. ECU_ADDRESS 0xE00B0000 FORMAT "%6.0"
 /begin IF_DATA XCP
  /begin DAQ_EVENT VARIABLE /begin DEFAULT_EVENT_LIST EVENT 0 EVENT 1 EVENT 2 EVENT 3 EVENT 4 /end DEFAULT_EVENT_LIST /end DAQ_EVENT
 /end IF_DATA
/end MEASUREMENT
/begin MEASUREMENT Measurement_12 "Preasure_chamber_12" UWORD CompuMethod_05 1 0. 0. 359.999 ECU_ADDRESS 0xE00C0000 FORMAT "%6.3"
 /begin IF_DATA XCP
  /begin DAQ_EVENT VARIABLE /begin DEFAULT_EVENT_LIST EVENT 0 EVENT 1 EVENT 2 EVENT 3 EVENT 4 /end DEFAULT_EVENT_LIST /end DAQ_EVENT
 /end IF_DATA
/end MEASUREMENT
/begin MEASUREMENT Measurement_13 "Preasure_chamber_13" UBYTE CompuMethod_02 1 0. 0. 255. ECU_ADDRESS 0xE00D0000 BIT_MASK 0x1F
 /begin IF_DATA XCP
  /begin DAQ_EVENT VARIABLE /begin DEFAULT_EVENT_LIST EVENT 0 EVENT 1 EVENT 2 EVENT 3 EVENT 4 /end DEFAULT_EVENT_LIST /end DAQ_EVENT
 /end IF_DATA
/end MEASUREMENT
/begin MEASUREMENT Measurement_14 "Preasure_chamber_14" UBYTE CompuMethod_02 1 0. 0. 255. ECU_ADDRESS 0xE00E0000 BIT_MASK 0x1F
 /begin IF_DATA XCP
  /begin DAQ_EVENT VARIABLE /begin DEFAULT_EVENT_LIST EVENT 0 EVENT 1 EVENT 2 EVENT 3 EVENT 4 /end DEFAULT_EVENT_LIST /end DAQ_EVENT
 /end IF_DATA
/end MEASUREMENT
/begin MEASUREMENT Measurement_15 "Preasure_chamber_15" UBYTE CompuMethod_02 1 0. 0. 255. ECU_ADDRESS 0xE00F0000 BIT_MASK 0x1F
 /begin IF_DATA XCP
  /begin DAQ_EVENT VARIABLE /begin DEFAULT_EVENT_LIST EVENT 0 EVENT 1 EVENT 2 EVENT 3 EVENT 4 /end DEFAULT_EVENT_LIST /end DAQ_EVENT
 /end IF_DATA
/end MEASUREMENT
/begin MEASUREMENT Measurement_16 "Preasure_chamber_16" UWORD CompuMethod_06 1 0. 0. 359.999 ECU_ADDRESS 0xE0100000 FORMAT "%6.3" ERROR_MASK 0x12345 /begin FUNCTION_LIST FUNC1 FUNC2 /end FUNCTION_LIST LAYOUT ROW_DIR MAX_REFRESH 1 54 READ_WRITE PHYS_UNIT "C" REF_MEMORY_SEGMENT TestOf_ref_memory_segment SYMBOL_LINK "LinkName" 0 /begin VIRTUAL Channel1 Channel2 /end VIRTUAL
 /begin IF_DATA XCP
  /begin DAQ_EVENT VARIABLE /begin DEFAULT_EVENT_LIST EVENT 0 EVENT 1 EVENT 2 EVENT 3 EVENT 4 /end DEFAULT_EVENT_LIST /end DAQ_EVENT
 /end IF_DATA
/end MEASUREMENT
/begin COMPU_VTAB compu_vtab_boolean "" TAB_VERB 2 0 "FALSE" 1 "TRUE" /end COMPU_VTAB
/begin COMPU_VTAB compu_vtab_example1 "" TAB_VERB 5 0 "compu_vtab_example1_level0" 1 "compu_vtab_example1_level1" 2 "compu_vtab_example1_level2" 11 "compu_vtab_example1_level11" 13 "compu_vtab_example1_level13" DEFAULT_VALUE "compu_vtab_example1_error" /end COMPU_VTAB
/begin COMPU_VTAB compu_vtab_example2 "" TAB_VERB 3 0 "compu_vtab_example2_Idle" 1 "compu_vtab_example2_Strtg" 2 "compu_vtab_example2_Actv" /end COMPU_VTAB
/begin COMPU_VTAB_RANGE compu_vtab_range_example1 "ÅÄÖ åäö" 3 0 1 "compu_vtab_example2_Idle" 1.1 3.5 "compu_vtab_example2_Strtg" 3.6 5.5 "compu_vtab_example2_Actv" /end COMPU_VTAB_RANGE
/end MODULE
/end PROJECT
