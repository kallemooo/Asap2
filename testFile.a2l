/*
* A2l file for testing ASAP2 parser.
*/ ASAP2_VERSION 1 60 A2ML_VERSION 1 1
/begin PROJECT project_name "project description"
/begin HEADER "Desc header" VERSION "version info" PROJECT_NO 12345 /end HEADER
/begin MODULE SYSTEM "Desc SYSTEM MODULE"
/begin MOD_COMMON "Desc mod_common" DEPOSIT ABSOLUTE ALIGNMENT_BYTE 1 BYTE_ORDER MSB_FIRST ALIGNMENT_WORD 2 ALIGNMENT_LONG 4 ALIGNMENT_INT64 8 ALIGNMENT_FLOAT32_IEEE 4 ALIGNMENT_FLOAT64_IEEE 4 /end MOD_COMMON
/begin IF_DATA XCP
 /begin PROTOCOL_LAYER 0x0100 2000 2000 2000 65535 2000 0005 0005 0x08 0x0008 BYTE_ORDER_MSB_LAST ADDRESS_GRANULARITY_BYTE SEED_AND_KEY_EXTERNAL_FUNCTION "SeedNKeyXcp.dll" /end PROTOCOL_LAYER
/end IF_DATA
/begin MEASUREMENT Measurement_1 "Measurement_1 description" UWORD NO_COMPU_METHOD 0 0 0 65535 ECU_ADDRESS 0x4000b6ee FORMAT "%8.5" /end MEASUREMENT
/begin MEASUREMENT /* Name */ Measurement_2_Array[0] /* LongIdentifier */ "Array test part 0.
        Row 2" /* Datatype */ UWORD /* Conversion */ NO_COMPU_METHOD /* Resolution */ 1 /* Accuracy */ 0 /* LowerLimit */ 0 /* UpperLimit */ 65535 ECU_ADDRESS 0x4000074c FORMAT "%8.5" /end MEASUREMENT
/begin MEASUREMENT /* Name */ Measurement_2_Array[1] /* LongIdentifier */ "Array test part 1." /* Datatype */ UWORD /* Conversion */ NO_COMPU_METHOD /* Resolution */ 1 /* Accuracy */ 0 /* LowerLimit */ 0 /* UpperLimit */ 65535 ECU_ADDRESS 0x4000074c FORMAT "%8.5" /end MEASUREMENT
/end MODULE
/end PROJECT
